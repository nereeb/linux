## Documentation/devicetree/bindings/clock/sunxi.txt
```
Device Tree Clock bindings for arch-sunxi

This binding uses the common clock binding[1].

[1] Documentation/devicetree/bindings/clock/clock-bindings.txt

Required properties:
- compatible : shall be one of the following:
	"allwinner,sunxi-osc-clk" - for a gatable oscillator
	"allwinner,sunxi-pll1-clk" - for the main PLL clock
	"allwinner,sunxi-cpu-clk" - for the CPU multiplexer clock
	"allwinner,sunxi-axi-clk" - for the sunxi AXI clock
	"allwinner,sunxi-axi-gates-clk" - for the AXI gates
	"allwinner,sunxi-ahb-clk" - for the sunxi AHB clock
	"allwinner,sunxi-ahb-gates-clk" - for the AHB gates
	"allwinner,sunxi-apb0-clk" - for the sunxi APB0 clock
	"allwinner,sunxi-apb0-gates-clk" - for the APB0 gates
	"allwinner,sunxi-apb1-clk" - for the sunxi APB1 clock
	"allwinner,sunxi-apb1-mux-clk" - for the sunxi APB1 clock muxing
	"allwinner,sunxi-apb1-gates-clk" - for the APB1 gates

Required properties for all clocks:
- reg : shall be the control register address for the clock.
- clocks : shall be the input parent clock(s) phandle for the clock
- #clock-cells : from common clock binding; shall be set to 0 except for
	"allwinner,sunxi-*-gates-clk" where it shall be set to 1

Additionally, "allwinner,sunxi-*-gates-clk" clocks require:
- clock-output-names : the corresponding gate names that the clock controls

For example:

osc24M: osc24M@01c20050 {
	#clock-cells = <0>;
	compatible = "allwinner,sunxi-osc-clk";
	reg = <0x01c20050 0x4>;
	clocks = <&osc24M_fixed>;
};

pll1: pll1@01c20000 {
	#clock-cells = <0>;
	compatible = "allwinner,sunxi-pll1-clk";
	reg = <0x01c20000 0x4>;
	clocks = <&osc24M>;
};

cpu: cpu@01c20054 {
	#clock-cells = <0>;
	compatible = "allwinner,sunxi-cpu-clk";
	reg = <0x01c20054 0x4>;
	clocks = <&osc32k>, <&osc24M>, <&pll1>;
};



Gate clock outputs

The "allwinner,sunxi-*-gates-clk" clocks provide several gatable outputs;
their corresponding offsets are listed below:

  * AXI gates ("allwinner,sunxi-axi-gates-clk")

    DRAM                                                                0

  * AHB gates ("allwinner,sunxi-ahb-gates-clk")

    USB0                                                                0
    EHCI0                                                               1
    OHCI0                                                               2*
    EHCI1                                                               3
    OHCI1                                                               4*
    SS                                                                  5
    DMA                                                                 6
    BIST                                                                7
    MMC0                                                                8
    MMC1                                                                9
    MMC2                                                                10
    MMC3                                                                11
    MS                                                                  12**
    NAND                                                                13
    SDRAM                                                               14

    ACE                                                                 16
    EMAC                                                                17
    TS                                                                  18

    SPI0                                                                20
    SPI1                                                                21
    SPI2                                                                22
    SPI3                                                                23
    PATA                                                                24
    SATA                                                                25**
    GPS                                                                 26*

    VE                                                                  32
    TVD                                                                 33
    TVE0                                                                34
    TVE1                                                                35
    LCD0                                                                36
    LCD1                                                                37

    CSI0                                                                40
    CSI1                                                                41

    HDMI                                                                43
    DE_BE0                                                              44
    DE_BE1                                                              45
    DE_FE0                                                              46
    DE_FE1                                                              47

    MP                                                                  50

    MALI400                                                             52

  * APB0 gates ("allwinner,sunxi-apb0-gates-clk")

    CODEC                                                               0
    SPDIF                                                               1*
    AC97                                                                2
    IIS                                                                 3

    PIO                                                                 5
    IR0                                                                 6
    IR1                                                                 7

    KEYPAD                                                              10

  * APB1 gates ("allwinner,sunxi-apb1-gates-clk")

    TWI0                                                                0
    TWI1                                                                1
    TWI2                                                                2

    CAN                                                                 4
    SCR                                                                 5
    PS20                                                                6
    PS21                                                                7

    UART0                                                               16
    UART1                                                               17
    UART2                                                               18
    UART3                                                               19
    UART4                                                               20
    UART5                                                               21
    UART6                                                               22
    UART7                                                               23

Notation:
 [*]:  The datasheet didn't mention these, but they are present on AW code
 [**]: The datasheet had this marked as "NC" but they are used on AW code
```

## arch/arm/configs/sunxi_defconfig
```kconfig
CONFIG_EXPERIMENTAL=y
CONFIG_SYSVIPC=y
CONFIG_BSD_PROCESS_ACCT=y
CONFIG_IKCONFIG=y
CONFIG_IKCONFIG_PROC=y
CONFIG_BLK_DEV_INITRD=y
CONFIG_INITRAMFS_SOURCE="/home/emilio/ramdisk/arm-probefs/probefs.cpio"
CONFIG_RD_LZO=y
CONFIG_INITRAMFS_COMPRESSION_LZO=y
CONFIG_EMBEDDED=y
CONFIG_JUMP_LABEL=y
CONFIG_PARTITION_ADVANCED=y
CONFIG_ARCH_SUNXI=y
CONFIG_AEABI=y
# CONFIG_OABI_COMPAT is not set
CONFIG_DEVTMPFS=y
CONFIG_SERIAL_8250=y
CONFIG_SERIAL_8250_CONSOLE=y
CONFIG_SERIAL_8250_EXTENDED=y
CONFIG_SERIAL_8250_DW=y
CONFIG_SERIAL_OF_PLATFORM=y
CONFIG_DEBUG_FS=y
CONFIG_DEBUG_LL=y
CONFIG_EARLY_PRINTK=y
```
